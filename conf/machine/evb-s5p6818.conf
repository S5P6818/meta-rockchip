## conf/machine/evb-s5p6818.conf
```bitbake
# Copyright (C) 2017 Fuzhou Rockchip Electronics Co., Ltd
# Released under the MIT license (see COPYING.MIT for the terms)

#@TYPE: Machine
#@NAME: EVB 3399

include conf/machine/include/s5p6818.inc

KERNEL_DEVICETREE = "rockchip/rk3328-evb.dtb"
UBOOT_MACHINE = "evb-rk3328_defconfig"
```
